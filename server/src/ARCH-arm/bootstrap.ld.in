/*
 * (c) 2008-2009 Adam Lackorzynski <adam@os.inf.tu-dresden.de>,
 *               Alexander Warg <warg@os.inf.tu-dresden.de>,
 *               Frank Mehnert <fm3@os.inf.tu-dresden.de>
 *     economic rights: Technische Universität Dresden (Germany)
 *
 * This file is part of TUD:OS and distributed under the terms of the
 * GNU General Public License 2.
 * Please see the COPYING-GPL-2 file for details.
 */

#include "ldscript.inc"

OUTPUT_FORMAT("elf32-littlearm", "elf32-bigarm",
              "elf32-littlearm")
OUTPUT_ARCH(arm)
ENTRY(_start)

PHDRS {
  common PT_LOAD;
  mods PT_LOAD;
}

SECTIONS
{
  /* Read-only sections, merged into text segment. The start address of
   * the text segment is : */
  . = LINKADDR;
  .text :
  {
    _stext = .;
    *(.text.init) 
    *(.init)
    *(.text .text.* .gnu.linkonce.t.*)
    *(.glue_7t) *(.glue_7)
    KEEP (*(.fini))
    LONG(0xc3)  /* terminate .fini */
    . = ALIGN(0x40);
    *(.rodata .rodata.* .gnu.linkonce.r.* .rodata1)
  } : common

  _etext = .;
  PROVIDE (etext = .);

  .note.gnu.build-id : { *(.note.gnu.build-id) }

  /* ensure that data starts at a new L4 page */
  . = ALIGN(4096);
  .data :
  {
    *(.data .data.* .gnu.linkonce.d.*)
    *(.anno)

    CTORS
    PLATFORMS
  } : common

  /* exception frames for C++ */
  .eh_frame :
  {
    KEEP (*(.eh_frame))
    LONG(0) /* terminate .eh_frame */
  } : common

  . = ALIGN(4);
  _edata  =  .;
  PROVIDE (edata = .);

  _bss_start = .;
  .bss :
  {
   *(.dynbss)
   *(.bss .bss.* .gnu.linkonce.b.*)
   *(COMMON)
  } : common
  _bss_end = .;

  /* Must be before _end so that they are retained even if modules are moved
   * around. In contrast, the .rel.dyn section is not needed after the
   * relocations have been processed. */
  .dynamic : { *(.dynamic) }
  .got     : { *(.got.plt) *(.got) }

  _end = . ;
  PROVIDE (end = .);

  .data.m :
  {
    _module_data_start = .;
    *(.module_data)
    _module_data_end = .;
  } : mods

  /* Moved here to ensure that these sections are located _after_ the text
   * section. In the other case we would get program sections with a virtual
   * address of 0 */
  .hash    : { *(.hash)    }
  .dynsym  : { *(.dynsym)  }
  .dynstr  : { *(.dynstr)  }

  .rel.dyn :
    {
      *(.rel.init)
      *(.rel.text .rel.text.* .rel.gnu.linkonce.t.*)
      *(.rel.fini)
      *(.rel.rodata .rel.rodata.* .rel.gnu.linkonce.r.*)
      *(.rel.data .rel.data.* .rel.gnu.linkonce.d.*)
      *(.rel.ctors)
      *(.rel.dtors)
      *(.rel.got)
      *(.rel.bss .rel.bss.* .rel.gnu.linkonce.b.*)
    }
  .rel.plt  : { *(.rel.plt) }

  /* drop the following sections since we do not need them for DROPS */
  /DISCARD/ : {
    *(.interp)
    *(.comment)
    *(.note)
    *(.stab)
    *(.fini)
    *(.ARM.exidx*)
  }
}

