## Kconfig.L4
```kconfig
menu "Bootstrap"

config BOOTSTRAP_THUMB_ENTRY
	bool "Thumb mode entry point"
	depends on BUILD_ARCH_arm
	help
	  Assume that bootstrap is started in Thumb mode.

	  If in doubt, choose n.

config BOOTSTRAP_COMPRESS
	bool "Support for compressed modules"
	depends on HAVE_BIDPC_ZLIB
	help
	  Allow bootstrap to decompress modules that have been compressed.
	  Using compressed modules reduces the size of an l4image at the cost of
	  increased startup time due to the required unpacking.

	  Modules will not be automatically compressed when building.

config BOOTSTRAP_CHECK_MD5
	bool "Enable module integrity check (MD5)"
	depends on HAVE_BIDPC_LIBBSD_LITE
	help
	  Enable module integrity check during boot using MD5. Only supported
	  for modules packed into an l4image.

comment "GZIP/ZLIB decompression not available due to missing zlib package"
	depends on !HAVE_BIDPC_ZLIB

source "server/src/platform/Kconfig.s32z"

source "server/src/platform/Kconfig.s32n"

source "server/src/platform/Kconfig.s32k5"

endmenu
```

## server/src/platform/Kconfig.s32k5
```kconfig
# Copyright 2025 NXP
# SPDX-License-Identifier: MIT

if PLATFORM_TYPE_s32k5

config BOOTSTRAP_PF_S32K5_DYN_ALLOC_OVERRIDE
	bool "Override dynamic allocation region"
	help
	  Specify region of dynamic allocations manually. By default the whole
	  CRAM region of the respective CPE is used.

if BOOTSTRAP_PF_S32K5_DYN_ALLOC_OVERRIDE

config BOOTSTRAP_PF_S32K5_DYN_ALLOC_START
	hex "Dynamic alloction base address"
	default 0x22000000
	help
	  Lower address of region where dynamic allocations are done. This
	  includes the multiboot information and possibly dynamic placement
	  of the initial tasks.

config BOOTSTRAP_PF_S32K5_DYN_ALLOC_END
	hex "Dynamic allocations end address"
	default 0x220FFFFF
	help
	  Upper address (inclusive) of region where dynamic allocations are
	  done.

endif # BOOTSTRAP_PF_S32K5_DYN_ALLOC_OVERRIDE

endif # PLATFORM_TYPE_s32k5
```

## server/src/platform/Kconfig.s32n
```kconfig
# Copyright 2023-2025 NXP
# SPDX-License-Identifier: MIT

if PLATFORM_TYPE_s32n5

choice
	prompt "RTU configuration"
	default BOOTSTRAP_PF_S32N_RTU_0

config BOOTSTRAP_PF_S32N_RTU_0
	bool "RTU0"
	depends on PLATFORM_TYPE_s32n5

config BOOTSTRAP_PF_S32N_RTU_1
	bool "RTU1"
	depends on PLATFORM_TYPE_s32n5

config BOOTSTRAP_PF_S32N_RTU_2
	bool "RTU2"
	depends on PLATFORM_TYPE_s32n5

config BOOTSTRAP_PF_S32N_RTU_3
	bool "RTU3"
	depends on PLATFORM_TYPE_s32n5

endchoice # BOOTSTRAP_PF_S32N_RTU

choice
	prompt "RTU Cluster 0 configuration"
	default BOOTSTRAP_PF_S32N_RTU_CL0_LOCKSTEP

config BOOTSTRAP_PF_S32N_RTU_CL0_DISABLED
	bool "disabled"

config BOOTSTRAP_PF_S32N_RTU_CL0_LOCKSTEP
	bool "lockstep"

config BOOTSTRAP_PF_S32N_RTU_CL0_SPLIT
	bool "split mode"

endchoice # BOOTSTRAP_PF_S32N_RTU_CL0

choice
	prompt "RTU Cluster 1 configuration"
	default BOOTSTRAP_PF_S32N_RTU_CL1_LOCKSTEP

config BOOTSTRAP_PF_S32N_RTU_CL1_DISABLED
	bool "disabled"

config BOOTSTRAP_PF_S32N_RTU_CL1_LOCKSTEP
	bool "lockstep"

config BOOTSTRAP_PF_S32N_RTU_CL1_SPLIT
	bool "split mode"

endchoice # BOOTSTRAP_PF_S32N_RTU_CL1

config BOOTSTRAP_PF_S32N_DYN_ALLOC_OVERRIDE
	bool "Override dynamic allocation region"
	help
	  Specify region of dynamic allocations manually. By default the whole
	  CRAM region of the respective RTU is used.

if BOOTSTRAP_PF_S32N_DYN_ALLOC_OVERRIDE

config BOOTSTRAP_PF_S32N_DYN_ALLOC_START
	hex "Dynamic alloction base address"
	default 0x39580000 if BOOTSTRAP_PF_S32N_RTU_0
	default 0x3b580000 if BOOTSTRAP_PF_S32N_RTU_1
	default 0x3d580000 if BOOTSTRAP_PF_S32N_RTU_2
	default 0x3f580000 if BOOTSTRAP_PF_S32N_RTU_3
	help
	  Lower address of region where dynamic allocations are done. This
	  includes the multiboot information and possibly dynamic placement
	  of the initial tasks.

config BOOTSTRAP_PF_S32N_DYN_ALLOC_END
	hex "Dynamic allocations end address"
	default 0x39ffffff if BOOTSTRAP_PF_S32N_RTU_0
	default 0x3bffffff if BOOTSTRAP_PF_S32N_RTU_1
	default 0x3dffffff if BOOTSTRAP_PF_S32N_RTU_2
	default 0x3fffffff if BOOTSTRAP_PF_S32N_RTU_3
	help
	  Upper address (inclusive) of region where dynamic allocations are
	  done.

endif # BOOTSTRAP_PF_S32N_DYN_ALLOC_OVERRIDE

endif # PLATFORM_TYPE_s32n5
```

## server/src/platform/Kconfig.s32z
```kconfig
if PLATFORM_TYPE_s32z

choice
	prompt "RTU0 configuration"
	default BOOTSTRAP_PF_S32Z_RTU0_LOCKSTEP

config BOOTSTRAP_PF_S32Z_RTU0_DISABLED
	bool "disabled"

config BOOTSTRAP_PF_S32Z_RTU0_LOCKSTEP
	bool "lockstep"

config BOOTSTRAP_PF_S32Z_RTU0_SPLIT
	bool "split mode"

endchoice

choice
	prompt "RTU1 configuration"
	default BOOTSTRAP_PF_S32Z_RTU1_LOCKSTEP

config BOOTSTRAP_PF_S32Z_RTU1_DISABLED
	bool "disabled"

config BOOTSTRAP_PF_S32Z_RTU1_LOCKSTEP
	bool "lockstep"

config BOOTSTRAP_PF_S32Z_RTU1_SPLIT
	bool "split mode"

endchoice

config BOOTSTRAP_PF_S32Z_DYN_ALLOC_OVERRIDE
	bool "Override dynamic allocation region"
	help
	  Specify region of dynamic allocations manually. By default the whole
	  CRAM region of the respective cluster is used.

if BOOTSTRAP_PF_S32Z_DYN_ALLOC_OVERRIDE

config BOOTSTRAP_PF_S32Z_DYN_ALLOC_START
	hex "Dynamic alloction base address"
	default 0x32100000
	help
	  Lower address of region where dynamic allocations are done. This
	  includes the multiboot information and possibly dynamic placement
	  of the initial tasks.

config BOOTSTRAP_PF_S32Z_DYN_ALLOC_END
	hex "Dynamic allocations end address"
	default 0x327fffff
	help
	  Upper address (inclusive) of region where dynamic allocations are
	  done.

endif

endif
```
